## arch/arm64/Kconfig.exynos
```kconfig
config MACH_EXYNOS9611_M30S_OPEN
	bool "Build Dtbo image for SM-M307"
	depends on SOC_EXYNOS9610
	default n
	help
	Say Y here if you want to enable building dtbo for Galaxy M30s.
```
